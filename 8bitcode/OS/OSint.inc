; Generated: Wed Jan 10 23:20:34 CET 2024
AN_RTS=0xf6e1
CLK_INIT_SQW=0xe59b
CLK_READ_TIME=0xe51d
CLK_WRITE_TIME=0xe556
DATA_END=0xdd25
DISPLAY_BACKSPACE=0xe076
DISPLAY_CHAR=0xe043
DISPLAY_CLEAR=0xe176
DISPLAY_GET_CURSOR_OFFSET=0xe19d
DISPLAY_GET_CURSOR_POS=0xe180
DISPLAY_GOTO_LINE=0xe02a
DISPLAY_GOTO_OFFSET=0xe037
DISPLAY_GOTO_POSITION=0xe02c
DISPLAY_HEX_BYTE=0xe000
DISPLAY_INIT=0xe1f5
DISPLAY_LINES=0xe03f
DISPLAY_LINES_END=0xe043
DISPLAY_MICRO_WAIT=0xe1f4
DISPLAY_MOVE_CURSOR_DOWN=0xe107
DISPLAY_MOVE_CURSOR_LEFT=0xe149
DISPLAY_MOVE_CURSOR_LEFT_INTERN=0xe171
DISPLAY_MOVE_CURSOR_RIGHT=0xe117
DISPLAY_MOVE_CURSOR_RIGHT_INTERN=0xe144
DISPLAY_NEW_LINE=0xe085
DISPLAY_READ_BYTE=0xe1d8
DISPLAY_READ_STATE=0xe1a6
DISPLAY_SCROLL_DOWN=0xe097
DISPLAY_SEND_BYTE=0xe252
DISPLAY_SEND_COMMAND=0xe24d
DISPLAY_SEND_DATA_BYTE=0xe27a
DISPLAY_SET_BACKLIGHT=0xe290
DISPLAY_STRING=0xe018
DISPLAY_WAIT_NOT_BUSY=0xe1ec
END_PGM=0xfe96
EOPCODE_TABLE=0xef54
FAT_CALCULATE_FIRST_DATA_SECTOR=0xe632
FAT_CALCULATE_FIRST_FAT_SECTOR=0xe60e
FAT_CALCULATE_FIRST_ROOT_DIR_SECTOR=0xe656
FAT_CALCULATE_ROOT_DIR_SECTORS=0xe690
FAT_CALCULATE_TOTAL_CLUSTERS=0xe6a7
FAT_CALCULATE_TOTAL_SECTORS=0xe703
FAT_CLUSTER_FILE_POINTER_TO_DIR_SECTOR=0xe9a2
FAT_CLUSTER_FILE_POINTER_TO_SECTOR=0xe81b
FAT_CLUSTER_TO_SECTOR=0xe843
FAT_FILE_POINTER_TO_ROOT_DIR_SECTOR=0xe7f4
FAT_FIND_DIR_ENTRY=0xe896
FAT_GET_FAT_OFFSET=0xe734
FAT_GET_FAT_SECTOR=0xe71d
FAT_GET_NEXT_CLUSTER=0xe73d
FAT_INIT=0xe5ae
FAT_NEXT_DIR_ENTRY=0xe9ae
FAT_READ_DIR_SECTOR=0xe7a6
FAT_READ_FAT_SECTOR=0xe758
GET_FAT_ENTRY_NAME=0xe940
IRQ=0xf9c5
IRQ_END=0xfa66
IRQ_NEXT_TASK=0xfa02
KEYBOARD_BYTE_TO_KEY=0xeb20
KEYBOARD_FUNCTION_KEY=0xec3d
KEYBOARD_GET_KEY=0xec84
KEYBOARD_GET_META_KEY_INDEX=0xec55
KEYBOARD_INIT=0xea13
KEYBOARD_READ_BYTE=0xea67
KEYBOARD_READ_BYTE_COND=0xea53
KEYBOARD_RESET_COUNTER=0xea3a
KEYBOARD_SEND_BYTE=0xea9d
KEYBOARD_SET_LEDS=0xec70
KEYBOARD_WAIT_1200=0xea7d
KEYBOARD_WAIT_150=0xea92
KEYBOARD_WAIT_CLOCK_HIGH=0xeb10
KEYBOARD_WAIT_CLOCK_LOW=0xeb00
KEYBOARD_WAIT_FOR_KEY=0xeca1
LEDkeybits=0xed20
LEDkeyscan=0xed0e
LOCK_FORCE_RELEASE=0xf230
LOCK_INIT=0xf1d4
LOCK_RELEASE=0xf212
LOCK_REQUEST=0xf1e1
MEM_ALLOC=0xede1
MEM_ALLOC_SINGLE=0xee18
MEM_FORCE_FREE=0xee68
MEM_FOUND=0xee05
MEM_FREE=0xee38
MEM_FREE_SINGLE=0xee36
MEM_INIT=0xedd4
MEM_NOT_FOUND=0xedff
OPCODE_TABLE=0xef17
OS_TO_UPPER=0xe988
PATH_LIST_SEARCH=0xf307
PIPE_CLOSE=0xf263
PIPE_GETC=0xf2ba
PIPE_OPEN=0xf247
PIPE_PUTC=0xf26c
RALT_map=0xece6
RALT_map_last=0xecf4
RELOCATE=0xee81
RESET=0xfa6b
SCB_COPY_FROM_FAT_ENTRY=0xf3d3
SCB_COPY_FROM_PIPE_ENTRY=0xf3f1
SCB_COPY_TO_FAT_ENTRY=0xf3e2
SCB_COPY_TO_PIPE_ENTRY=0xf402
SCB_GET_FREE_SCB=0xf38d
SCB_GET_INDEX=0xf3b4
SCB_GET_INDEX_FOR_FD=0xf3ae
SCB_INIT=0xf37f
SCB_SET_POINTER=0xf3c3
SDCARD_INIT=0xe2fc
SDCARD_LBLOCK_TO_ADDRESS=0xe443
SDCARD_READ_32BIT_RESPONSE=0xe42a
SDCARD_READ_BLOCK=0xe462
SDCARD_READ_LBLOCK=0xe45f
SDCARD_SEND_COMMAND=0xe404
SDCARD_WAIT=0xe3f3
SDCARD_WRITE_BLOCK=0xe4ba
SDCARD_WRITE_LBLOCK=0xe4b7
SPI_DESELECT_CHIPS=0xe2cd
SPI_GET_SELECTED_CHIP=0xe2c8
SPI_INIT=0xe2ea
SPI_RECEIVE_BYTE=0xe2c0
SPI_RECEIVE_RESPONSE_BYTE=0xe29d
SPI_SELECT_CHIP=0xe2df
SPI_SELECT_CHIP0=0xe2d8
SPI_SELECT_CHIP1=0xe2dd
SPI_SEND_BYTE=0xe2c4
SYS_ADD_MODULE=0xf917
SYS_ADD_MODULES=0xf898
SYS_ALLOC_PROGRAM_DATA=0xfe03
SYS_CALL_PROGRAM=0xfe00
SYS_CLOSE=0xf6e2
SYS_CLOSE_DIR=0xf82b
SYS_CLOSE_STREAM=0xf6f7
SYS_CON_CLOSE=0xf733
SYS_CON_GETC=0xf649
SYS_CON_OPEN=0xf553
SYS_CON_PUTC=0xf5c9
SYS_COPY_STRING_LIST=0xfc6f
SYS_END_TASK=0xfc98
SYS_EXEC=0xfd06
SYS_FORK=0xfb6e
SYS_FORK_CONS=0xfb73
SYS_FREE_START_MEM=0xfddd
SYS_FSSTAT=0xf842
SYS_FS_CLOSE=0xf713
SYS_FS_OPEN=0xf50d
SYS_GETC=0xf604
SYS_GET_FILE_TYPE=0xf4a1
SYS_GET_KEY=0xf691
SYS_GET_TICKS=0xfe6c
SYS_GET_VERSION_STRING=0xf49c
SYS_INIT_TASK=0xfb1b
SYS_IO_END=0xf6d7
SYS_LOCK_EXEC=0xfe40
SYS_LOCK_FAT_FS=0xf84c
SYS_LOCK_PIPE=0xf86c
SYS_MEM_ALLOC=0xf88c
SYS_MEM_FREE=0xf892
SYS_MKDIR=0xf82e
SYS_NEXT_DIR=0xf795
SYS_OK_END=0xf6f5
SYS_OPEN=0xf4e4
SYS_OPEN_DIR=0xf790
SYS_OPEN_STREAM=0xf4fe
SYS_PIPE_CLOSE=0xf741
SYS_PIPE_GETC=0xf66a
SYS_PIPE_OPEN=0xf576
SYS_PIPE_PUTC=0xf5db
SYS_PUTC=0xf593
SYS_READ=0xf6a4
SYS_READ_INT=0xf6b3
SYS_READ_PROGRAM_TRAILER=0xf8eb
SYS_SEEK=0xf752
SYS_SHOW_ERROR=0xfe60
SYS_SLEEP=0xfe7a
SYS_START_CONSOLE=0xfacd
SYS_STAT=0xf77d
SYS_TASK_SIGNAL=0xfcc4
SYS_TELL=0xf76a
SYS_UNLINK=0xf838
SYS_UNLOCK_EXEC=0xfe50
SYS_UNLOCK_FAT_FS=0xf85c
SYS_UNLOCK_PIPE=0xf87c
SYS_WAIT_TASK=0xfb5b
SYS_WRITE=0xf6bf
SYS_WRITE_INT=0xf6c8
TASKENV_GET_VAR=0xef6b
TASK_CREATE_FD=0xf0b4
TASK_FD_TO_SD=0xf08a
TASK_FIND_TID=0xf0e3
TASK_FORCE_SWITCH=0xf0da
TASK_GET_BLOCK_POINTER=0xf052
TASK_GET_ENV_POINTER=0xf11b
TASK_GET_INFO=0xf168
TASK_GET_LIST=0xf128
TASK_GET_STACK_POINTER=0xf05e
TASK_INIT=0xefb6
TASK_NEW=0xefd6
TASK_OK_END=0xf088
TASK_REMOVE=0xf076
TASK_REMOVE_FD=0xf0a2
TASK_SET_STACK_POINTER=0xf06a
TCB_OFF_CMD=0x1a
TCB_OFF_CONS=0x17
TCB_OFF_ENV=0x18
TCB_OFF_FILES=0x2
TCB_OFF_PARENT=0x15
TCB_OFF_TICKS=0x12
TCB_OFF_TID=0x0
TIB_OFF_CMD=0x6
TIB_OFF_CONS=0x5
TIB_OFF_PARENT=0x3
TIB_OFF_TICKS=0x0
_LOCK_ILLEGAL=0xf20e
_TASK_FILE_ERROR_END=0xf09e
boot_dir_name=0xf42d
con_close_ptr=0xdd1d
con_in_ptr=0xdd21
con_open_ptr=0xdd1b
con_out_ptr=0xdd1f
con_visible_ptr=0xdd23
data_mem_start=0xdb2b
data_page=0xdcf0
data_pages=0xdcef
data_section_end=0xdb29
data_section_size=0xdced
data_section_start=0xdb27
dir_entry_area=0xdc96
display_cursor_col=0xd621
display_light_state=0xd620
display_scroll_buffer=0xd622
fail_msg=0xf468
fat_block_buffer=0xd6af
fat_block_buffer_sector=0xd6a7
fat_boot_sector_address=0xd68e
fat_dir_buffer=0xd8af
fat_dir_buffer_sector=0xd6ab
fat_dir_entry_pointer=0xd67f
fat_entry_name=0xd673
fat_file_active_cluster=0xdcff
fat_file_area=0xdcf7
fat_file_area_end=0xdd05
fat_file_buffer_pointer=0xdcfd
fat_file_dir_index=0xdcfb
fat_file_dir_sector=0xdcf7
fat_file_mode=0xdcfc
fat_file_pointer=0xdd01
fat_first_data_sector=0xd69f
fat_first_root_dir_sector=0xd69b
fat_first_sector=0xd697
fat_fs_close_ptr=0xdd07
fat_fs_flush_ptr=0xdd19
fat_fs_fsstat_ptr=0xdd17
fat_fs_mkdir_ptr=0xdd11
fat_fs_open_ptr=0xdd05
fat_fs_read_ptr=0xdd09
fat_fs_seek_ptr=0xdd0d
fat_fs_stat_ptr=0xdd15
fat_fs_tell_ptr=0xdd0f
fat_fs_unlink_ptr=0xdd13
fat_fs_write_ptr=0xdd0b
fat_name_pointer=0xd66f
fat_name_start_pointer=0xd671
fat_number_of_fats=0xd696
fat_root_dir_sectors=0xd6a3
fat_sector_in_cluster_offset_mask=0xd695
fat_sectors_for_one_fat=0xd692
fat_sectors_per_cluster=0xd694
fat_total_clusters=0xd6a5
fat_trials_left_cnt=0xd681
fat_work_cluster=0xd682
fat_work_cluster_index=0xd688
fat_work_file_pointer=0xd68a
fat_work_sector=0xd684
file_byte=0xdc95
file_number=0xdc94
file_read=0xd600
fork_aux_pointer=0xdcf3
fork_console=0xdcf6
fork_file_count=0xdcf5
functionkeyscan=0xecf6
init_card_msg=0xf446
init_keyboard_msg=0xf434
keyboard_bitCnt=0xdaaf
keyboard_bufRPtr=0xdab3
keyboard_bufWPtr=0xdab2
keyboard_buffer=0xdab4
keyboard_keystate=0xdab0
keyboard_keystate2=0xdab1
keyboard_special_key=0xdac4
keytab=0xed26
keytab_caps=0xed7d
keytab_end=0xedd4
lock_owners=0xdb88
mem_reserve=0xdac5
metakeybits=0xed14
metakeyscan=0xed02
mod_too_large=0xf46f
numpadlockscan=0xecd1
numpadscan=0xecbc
os_save_area=0xd610
os_save_copy=0xd610
path_file_name=0xdbb4
path_name_ptr=0xdbb0
path_var_name=0xf497
pgm_end=0xdceb
pgm_page=0xdcf2
pgm_pages=0xdcf1
pgm_start=0xdb25
pipe_area=0xdba8
pipe_area_end=0xdbaf
pipe_buf_ptr=0xdba8
pipe_empty=0xdbae
pipe_read_ptr=0xdbaa
pipe_use_cnt=0xdbaf
pipe_write_ptr=0xdbac
ready_msg=0xf458
scb_area=0xdbf4
scb_pointer=0xd604
sdcard_block_address=0xd667
sdcard_buffer_pointer=0xd66b
sdcard_cmd_crc=0xd662
sdcard_cmd_parm=0xd65e
sdcard_cmd_response=0xd663
search_name_ptr=0xdbb2
sys_con_filename=0xdcb7
sys_con_pref=0xf47e
sys_fork_area=0xdcbd
sys_fork_filedesc=0xdcbd
sys_fork_filename=0xdcc0
sys_init_con=0xdcb6
sys_init_con_file=0xf489
sys_init_shell=0xf48f
sys_pipe_pref=0xf483
sys_ticks=0xdce8
task_active=0xdb2f
task_active_block=0xdb30
task_aux_pointer=0xdb86
task_aux_tid=0xdb84
task_blocks=0xdb42
task_next_tid=0xdb82
task_stacks=0xdb62
task_status=0xdb32
taskenv_var_ptr=0xdb2d
verstime=0xf419
